## config/boards/shields/JeffTrinkle_Cyboard/Kconfig.shield
```kconfig
# Copyright (c) 2020 Pete Johanson
# SPDX-License-Identifier: MIT

config SHIELD_JEFF_TRINKLE_CYBOARD_LEFT
	def_bool $(shields_list_contains,jeff_trinkle_cyboard_left)

config SHIELD_JEFF_TRINKLE_CYBOARD_RIGHT
	def_bool $(shields_list_contains,jeff_trinkle_cyboard_right)
```

## config/boards/shields/hernandez_cyboard/Kconfig.shield
```kconfig
# Copyright (c) 2020 Pete Johanson
# SPDX-License-Identifier: MIT

config SHIELD_HERNANDEZ_CYBOARD_LEFT
	def_bool $(shields_list_contains,hernandez_cyboard_left)

config SHIELD_HERNANDEZ_CYBOARD_RIGHT
	def_bool $(shields_list_contains,hernandez_cyboard_right)
```

## config/boards/shields/jeff_trinkle_cyboard/Kconfig.defconfig
```kconfig
if SHIELD_JEFF_TRINKLE_CYBOARD_RIGHT

config ZMK_KEYBOARD_NAME
	default "JCT's Cyboard"

config ZMK_SPLIT_BLE_ROLE_CENTRAL
	default y

endif

if SHIELD_JEFF_TRINKLE_CYBOARD_LEFT || SHIELD_JEFF_TRINKLE_CYBOARD_RIGHT

config ZMK_SPLIT
	default y

endif
```

## config/boards/shields/peilert_cyboard/Kconfig.defconfig
```kconfig
if SHIELD_PEILERT_CYBOARD_LEFT

config ZMK_KEYBOARD_NAME
	default "Peilert Cyboard"

config ZMK_SPLIT_BLE_ROLE_CENTRAL
	default y

endif

if SHIELD_PEILERT_CYBOARD_LEFT || SHIELD_PEILERT_CYBOARD_RIGHT

config ZMK_SPLIT
	default y

endif
```

## config/boards/shields/peilert_cyboard/Kconfig.shield
```kconfig
# Copyright (c) 2020 Pete Johanson
# SPDX-License-Identifier: MIT

config SHIELD_PEILERT_CYBOARD_LEFT
	def_bool $(shields_list_contains,peilert_cyboard_left)

config SHIELD_PEILERT_CYBOARD_RIGHT
	def_bool $(shields_list_contains,peilert_cyboard_right)
```

## config/boards/shields/thompson_cyboard/Kconfig.defconfig
```kconfig
if SHIELD_THOMPSON_CYBOARD_LEFT

config ZMK_KEYBOARD_NAME
	default "Thompson Cyboard"

config ZMK_SPLIT_BLE_ROLE_CENTRAL
	default y

endif

if SHIELD_THOMPSON_CYBOARD_LEFT || SHIELD_THOMPSON_CYBOARD_RIGHT

config ZMK_SPLIT
	default y

endif
```

## config/boards/shields/thompson_cyboard/Kconfig.shield
```kconfig
# Copyright (c) 2020 Pete Johanson
# SPDX-License-Identifier: MIT

config SHIELD_THOMPSON_CYBOARD_LEFT
	def_bool $(shields_list_contains,thompson_cyboard_left)

config SHIELD_THOMPSON_CYBOARD_RIGHT
	def_bool $(shields_list_contains,thompson_cyboard_right)
```

## config/west.yml
```yaml
manifest:
  remotes:
    - name: zmkfirmware
      url-base: https://github.com/zmkfirmware
    - name: Cyboard-DigitalTailor
      url-base: https://github.com/Cyboard-DigitalTailor
  projects:
    - name: zmk
      remote: Cyboard-DigitalTailor
      revision: main
      import: app/west.yml
  self:
    path: config
```
