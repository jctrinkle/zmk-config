/*
 * Copyright (c) 2020 Pete Johanson
 *
 * SPDX-License-Identifier: MIT
 */

#include "peilert_cyboard.dtsi"

&kscan0 {
	col-gpios
		= <&pro_micro 9 GPIO_ACTIVE_HIGH> //should be 8
		, <&pro_micro 7 GPIO_ACTIVE_HIGH>
		, <&pro_micro 10 GPIO_ACTIVE_HIGH> //should be 6
		, <&pro_micro 5 GPIO_ACTIVE_HIGH>
		, <&pro_micro 4 GPIO_ACTIVE_HIGH>
		, <&pro_micro 3 GPIO_ACTIVE_HIGH>
		, <&pro_micro 14 GPIO_ACTIVE_HIGH> //should be 2
		, <&pro_micro 16 GPIO_ACTIVE_HIGH> //should be 0
		;
};
